## src/mainboard/dell/snb_ivb_workstations/Kconfig.name
```kconfig
## SPDX-License-Identifier: GPL-2.0-only

config BOARD_DELL_OPTIPLEX_7010_MT
	bool "OptiPlex 7010 MT"

config BOARD_DELL_OPTIPLEX_7010_SFF
	bool "OptiPlex 7010 SFF"

config BOARD_DELL_OPTIPLEX_9010_MT
	bool "OptiPlex 9010 MT"

config BOARD_DELL_OPTIPLEX_9010_SFF
	bool "OptiPlex 9010 SFF"

config BOARD_DELL_PRECISION_T1650
        bool "Precision T1650"
```
